## drivers/input/sensors/Kconfig
```kconfig
# SPDX-License-Identifier: GPL-2.0
#
# all sensors drivers configuration
#

comment "handle all sensors"

menuconfig SENSOR_DEVICE
	tristate "handle angle,accel,compass,gyroscope,lsensor psensor etc"
	default n
	
if SENSOR_DEVICE
source "drivers/input/sensors/accel/Kconfig"

endif
```

## drivers/input/sensors/accel/Kconfig
```kconfig
# SPDX-License-Identifier: GPL-2.0
#
# gsensor drivers configuration
#

menuconfig GSENSOR_DEVICE
	tristate "g_sensor device support"
	default n
	help
	  Enable this to be able to choose the drivers for controlling the
	  g_sensor on some platforms, for example on PDAs.

if GSENSOR_DEVICE

config MPU6880_ACC
	tristate "Sensor mpu6880_acc"
	default n
	help
	  To have support for your specific gsesnor you will have to
	  select the proper drivers which depend on this option.

config MPU6500_ACC
	tristate "Sensor mpu6500_acc"
	default n
	help
	  To have support for your specific gsesnor you will have to
	  select the proper drivers which depend on this option.
endif
```

## drivers/net/wireless/realtek/rtl8188eu/Kconfig
```kconfig
config RTL8188EU
	tristate "Realtek 8188E USB WiFi"
	depends on USB
	help
	  message of RTL8188EU
```
